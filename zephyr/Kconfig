## zephyr/Kconfig
```kconfig
source "$ZEPHYR_BASE/Kconfig.zephyr"
menu "ENS contact storage"

config ENS_MAX_CONTACTS
    int "Max contacts in storage"
    default 2048
    help
      The maximum amount of contacts, that can be stored on the devices. Needs to be a power of 2!

endmenu

menu "Protobuf"

config TEST_UNPACK_KEYS_N
    int ""
    default 0

config TEST_UNPACK_KEYS
    bool ""
    default n
    select TIMING_FUNCTIONS

endmenu

menu "Contact Tests"

config TEST_RECORDS_PER_INTERVAL
  int "Records per interval"
  default 120
  help
    Number of records per interval.

config TEST_INFECTED_RATE
  int ""
  range 0 100
  default 1
  help
    The rate for infected intervals in test data.

config CONTACTS_PERFORM_RISC_CHECK_TEST
  bool ""
  default n
  help 
    Flag for performing tests. WARNING: This deletes all currently stored records.

config CONTACTS_RISC_CHECK_TEST_PUBLIC_INTERVAL_COUNT
  int ""
  default 1024
  help
    Amount of interval identifiers to test against stored test data. 

config CONTACTS_BLOOM_REVERSE 
  bool ""
  default n
  help
    Flag for toggling between bloom variants. Yes means, that the reverse bloom filter is used.
endmenu
```

## zephyr/boards/native_posix_64.conf
```kconfig
CONFIG_SDL_DISPLAY_DEV_NAME="DISPLAY"
CONFIG_SDL_DISPLAY_X_RES=240
CONFIG_SDL_DISPLAY_Y_RES=240

CONFIG_KSCAN=y
CONFIG_LVGL_POINTER_KSCAN=y
CONFIG_LVGL_HOR_RES_MAX=240
CONFIG_LVGL_VER_RES_MAX=240
CONFIG_LVGL_DPI=100


CONFIG_DISPLAY=y
CONFIG_DISPLAY_LOG_LEVEL_ERR=y
```

## zephyr/dts/bindings/power/simple-battery.yaml
```yaml
# Copyright (c) 2020, Tobias Schramm <t.schramm@t-sys.eu>
# SPDX-License-Identifier: Apache-2.0

description: |
    Description for a battery

compatible: "simple-battery"

include: base.yaml

properties:
    soc-voltage-mv:
      type: array
      required: true
      description: |
        Array containing pairs of state-of-charge and associated
        open circuit battery voltage in millivolts
```
