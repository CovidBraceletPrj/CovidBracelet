## CMakeLists.txt
```
# SPDX-License-Identifier: Apache-2.0

cmake_minimum_required(VERSION 3.13.1)
find_package(Zephyr REQUIRED HINTS $ENV{ZEPHYR_BASE})
project(bluecovid)

target_sources(app PRIVATE src/main.c src/contacts.c src/exposure-notification.c src/gatt-service.c src/covid.c) 

zephyr_include_directories(${APPLICATION_SOURCE_DIR}/src/tls_config)

#use for testing only, will update keys every X seconds, default is 600
#add_definitions(-DEN_INTERVAL_LENGTH=11)
#add_definitions(-DEN_INTERVAL_LENGTH=1)
```

## prj.conf
```kconfig
CONFIG_BT=y
CONFIG_BT_BROADCASTER=y
CONFIG_BT_OBSERVER=y
CONFIG_BT_DEBUG_LOG=y
CONFIG_BT_SMP=y
CONFIG_BT_PERIPHERAL=y
CONFIG_BT_DEVICE_NAME="BlueCovid"
CONFIG_ENTROPY_GENERATOR=y

CONFIG_MBEDTLS=y
#CONFIG_MBEDTLS_USER_CONFIG_ENABLE=y
#CONFIG_MBEDTLS_CFG_FILE="mbedtls_config.h"
CONFIG_MBEDTLS_USER_CONFIG_ENABLE=y
CONFIG_MBEDTLS_USER_CONFIG_FILE="user-tls.conf"

#CONFIG_BT_HCI_TX_STACK_SIZE=1024
CONFIG_SYSTEM_WORKQUEUE_STACK_SIZE=2048
```

## src/main.c
```c
/* main.c - Application main entry point */

/*
 * Copyright (c) 2020 Olaf Landsiedel
 *
 * SPDX-License-Identifier: Apache-2.0
 */

#include <zephyr.h>

#include <bluetooth/hci.h>
#include <random/rand32.h>
#include <sys/printk.h>

#include "record_storage.h"
#include "tek_storage.h"
#include "sync_service.h"
#include "tracing.h"
#include "bloom.h"

#include "mbedtls/platform.h"


/**
 * Fill the bloom filter with all stored records.
 */
void fill_bloom_with_stored_records(bloom_filter_t* bloom) {
    // init iterator for filling bloom filter
    record_iterator_t iterator;
    int rc = ens_records_iterator_init_timerange(&iterator, NULL, NULL);
    if (rc) {
        printk("init iterator failed0 (err %d)\n", rc);
        return;
    }

    // fill bloom filter with records
    record_t* current;
    while ((current = ens_records_iterator_next(&iterator))) {
        bloom_add_record(bloom, &(current->rolling_proximity_identifier));
    }
}

void main(void) {

    int err = 0;
    printk("Starting Contact-Tracing Wristband...\n");

     int ret = 0;

    if((ret = mbedtls_platform_setup(NULL)) != 0) {
        mbedtls_printf("Platform initialization failed with error %d\r\n", ret);
        return 1;
    }

    // Use custom randomization as the mbdet_tls context initialization messes with the Zeyhr BLE stack.
    err = en_init(sys_csrand_get);
    if (err) {
        printk("Crypto init failed (err %d)\n", err);
        return;
    }

    err = record_storage_init(true);
    if (err) {
        printk("init record storage failed (err %d)\n", err);
        return;
    }


    err = tek_storage_init(false);
    if (err) {
        printk("init key storage failed (err %d)\n", err);
        return;
    }

    k_msleep(10000);

    printk("Filling record storage...\n");
    reset_record_storage();

    tek_t tek;
    ENPeriodIdentifierKey pik;

    tek_storage_get_latest_at_ts(&tek, 0);
    en_derive_period_identifier_key(&pik, &tek.tek);


    bloom_filter_t* bf = bloom_init(0); // size not used atm

    /// we now fill the whole flash memory with stupid data
    for (int i = 0; i < CONFIG_ENS_MAX_CONTACTS; ++i) {
        record_t dummy_record;
        en_derive_interval_identifier((ENIntervalIdentifier*)&dummy_record.rolling_proximity_identifier, &pik, i);
        dummy_record.timestamp = i; // very clever! ;)
        bloom_add_record(bf, &dummy_record.rolling_proximity_identifier);
        if (!bloom_probably_has_record(bf, &dummy_record.rolling_proximity_identifier)) {
            printk("error!  bloom_probably_has_record\n");
        }
    }
    printk("Done...\n");
    k_msleep(2000);

    printk("Creating bloom filter...\n");
    fill_bloom_with_stored_records(bf);
    printk("Done...\n");
    k_msleep(3000);

    do {
        printk("Checking keys...\n");
        for(int k = 0; k < 144; k++) {

            ENIntervalIdentifier rpi;
            en_derive_period_identifier_key(&pik, &tek.tek);
            // derive all RPIs
            for (int j = 0; j < 144; j++) {

                // we assume that at least one out of 144 RPIs was met (this is still a lot actually!)
                uint32_t interval = j == 0 ? (CONFIG_ENS_MAX_CONTACTS / 144)*k : (CONFIG_ENS_MAX_CONTACTS+1);
                en_derive_interval_identifier(&rpi, &pik, interval); //one of each is actually

                uint32_t num_met = 0;
                if (bloom_probably_has_record(bf, &rpi)) {
                    num_met++;
                    /*
                    record_iterator_t iterator;

                    time_t start = interval == 0 ? 0 : (interval+(CONFIG_ENS_MAX_CONTACTS-1)) % CONFIG_ENS_MAX_CONTACTS;
                    time_t end = (interval+(CONFIG_ENS_MAX_CONTACTS+1)) % CONFIG_ENS_MAX_CONTACTS;

                    int rc = ens_records_iterator_init_timerange(&iterator, &start, &end);
                    if (rc) {
                        // on error, skip this rpi
                        printk("iterator error! %d\n", rc);
                        continue;
                    }
                    record_t* current;
                    while ((current = ens_records_iterator_next(&iterator))) {
                        if (memcmp(&(current->rolling_proximity_identifier), rpi.b,
                                   sizeof(current->rolling_proximity_identifier)) == 0) {
                            num_met++;
                        }
                    }
                    ens_record_iterator_clear(&iterator);*/
                }
                if(j == 0 && num_met == 0) {
                    printk("Met mismatch! %u\n", num_met);
                }
            }

        }
        k_sleep(K_MSEC(2000));
    } while (1);
}
```

## include/bloom.h
```c
#ifndef BLOOM_H
#define BLOOM_H

#include "record_storage.h"
#include "exposure-notification.h"

typedef struct {
    uint8_t* data;
    size_t size;
} bloom_filter_t;

/**
 * Initialize the bloom filter on basis of the already registerred records.
 */
bloom_filter_t* bloom_init(size_t size);

void bloom_destroy(bloom_filter_t* bloom);

// TODO lome: maybe only use RPI (should be sufficient)
void bloom_add_record(bloom_filter_t* bloom, ENIntervalIdentifier* rpi);

// TODO lome: maybe only use RPI (should be sufficient)
bool bloom_probably_has_record(bloom_filter_t* bloom, ENIntervalIdentifier* rpi);

#endif
```

## include/contacts.h
```c
/*
 * Copyright (c) 2020 Olaf Landsiedel
 *
 * SPDX-License-Identifier: Apache-2.0
 */

#ifndef CONTACTS_H
#define CONTACTS_H

#include <zephyr.h>
#include <zephyr/types.h>

#include "covid.h"
#include "covid_types.h"
#include "ens/storage.h"
#include "exposure-notification.h"

typedef struct {
    ENIntervalIdentifier interval_identifier;
    int met;
    time_t search_start;
    time_t search_end;
} __packed infected_for_interval_ident_ctx_t;

typedef struct {
    ENPeriodKey periodKey;
    time_t start;
    int met;
} __packed period_key_information_t;

typedef int (*test_func_t)(infected_for_interval_ident_ctx_t* infectedIntervals, int count);

void print_key(_ENBaseKey* key);
void print_rpi(rolling_proximity_identifier_t* rpi);
void print_aem(associated_encrypted_metadata_t* aem);

/**
 * Register a new record in the system. This includes adding it to the storage and adding it to the bloom filter.
 *
 * @param record record to add
 * @returns 0 in case of success, -ERRNO in case of an error
 */
int register_record(record_t* record);

/**
 * Initialize the contacts module.
 */
int init_contacts();

/**
 * Check for a list of specified interval identifiers, whether they were probably met or not.
 * @param ctx list of interval identifiers to check
 * @param count amount of identifiers to check
 * @return the amount of met intervals, -ERRNO on error
 */
int check_possible_contacts_for_intervals(infected_for_interval_ident_ctx_t* ctx, int count);

/**
 * Check for a list of specified period keys, whether they were probably met or not.
 * @param ctx list of period keys and their meta information to check
 * @param count amount of period keys to check
 * @return -ERRNO on error, 0 otherwise
 */
int check_possible_contacts_for_periods(period_key_information_t periodKeyInformation[], int count);

#endif
```

## include/covid.h
```c
/*
 * Copyright (c) 2020 Olaf Landsiedel
 *
 * SPDX-License-Identifier: Apache-2.0
 */

#ifndef COVID_H
#define COVID_H

#include <zephyr.h>

#include "exposure-notification.h"

typedef struct period{
	ENPeriodKey periodKey;
	ENIntervalNumber periodInterval;
} __packed period_t;

int init_covid();
int do_covid();

bool get_infection();
void set_infection(bool _infected);
unsigned int get_period_cnt_if_infected();
period_t* get_period_if_infected(unsigned int id, size_t* size);

int get_index_by_interval(ENIntervalNumber periodInterval);


void print_periods();
#endif
```

## include/covid_types.h
```c
/*
 * Copyright (c) 2020 Olaf Landsiedel
 *
 * SPDX-License-Identifier: Apache-2.0
 */

#ifndef COVID_TYPES_H
#define COVID_TYPES_H

#include <exposure-notification.h>
#include <zephyr.h>
#include <zephyr/types.h>

#define COVID_ROLLING_PROXIMITY_IDENTIFIER_LEN 16

typedef ENIntervalIdentifier rolling_proximity_identifier_t;

typedef struct bt_metadata {
    uint8_t version;
    uint8_t tx_power;
    uint8_t rsv1;
    uint8_t rsv2;
} __packed bt_metadata_t;

// typedef struct bt_metadata bt_metadata_t;

typedef struct associated_encrypted_metadata {
    uint8_t data[sizeof(bt_metadata_t)];
} __packed associated_encrypted_metadata_t;

typedef uint8_t rssi_t;

#endif
```

## include/export.pb-c.h
```c
/* Generated by the protocol buffer compiler.  DO NOT EDIT! */
/* Generated from: export.proto */

#ifndef PROTOBUF_C_export_2eproto__INCLUDED
#define PROTOBUF_C_export_2eproto__INCLUDED

#include <protobuf-c.h>

PROTOBUF_C__BEGIN_DECLS

#if PROTOBUF_C_VERSION_NUMBER < 1000000
# error This file was generated by a newer version of protoc-c which is incompatible with your libprotobuf-c headers. Please update your headers.
#elif 1004000 < PROTOBUF_C_MIN_COMPILER_VERSION
# error This file was generated by an older version of protoc-c which is incompatible with your libprotobuf-c headers. Please regenerate this file with a newer version of protoc-c.
#endif


typedef struct TemporaryExposureKeyExport TemporaryExposureKeyExport;
typedef struct SignatureInfo SignatureInfo;
typedef struct TemporaryExposureKey TemporaryExposureKey;
typedef struct TEKSignatureList TEKSignatureList;
typedef struct TEKSignature TEKSignature;


/* --- enums --- */

/*
 * Data type representing why this key was published.
 */
typedef enum _TemporaryExposureKey__ReportType {
  /*
   * Never returned by the client API.
   */
  TEMPORARY_EXPOSURE_KEY__REPORT_TYPE__UNKNOWN = 0,
  TEMPORARY_EXPOSURE_KEY__REPORT_TYPE__CONFIRMED_TEST = 1,
  TEMPORARY_EXPOSURE_KEY__REPORT_TYPE__CONFIRMED_CLINICAL_DIAGNOSIS = 2,
  TEMPORARY_EXPOSURE_KEY__REPORT_TYPE__SELF_REPORT = 3,
  TEMPORARY_EXPOSURE_KEY__REPORT_TYPE__RECURSIVE = 4,
  /*
   * Used to revoke a key, never returned by client API.
   */
  TEMPORARY_EXPOSURE_KEY__REPORT_TYPE__REVOKED = 5
    PROTOBUF_C__FORCE_ENUM_TO_BE_INT_SIZE(TEMPORARY_EXPOSURE_KEY__REPORT_TYPE)
} TemporaryExposureKey__ReportType;

/* --- messages --- */

/*
 * Protobuf definition for exports of confirmed temporary exposure keys.
 * The full file format is documented under "Exposure Key Export File Format
 * and Verification" at https://www.google.com/covid19/exposurenotifications/
 * These files have a 16-byte, space-padded header before the protobuf data
 * starts. They will be contained in a zip archive, alongside a signature
 * file verifying the contents.
 */
struct  TemporaryExposureKeyExport
{
  ProtobufCMessage base;
  /*
   * Time window of keys in this file based on arrival to server, in UTC
   * seconds. start_timestamp, end_timestamp, and batch_num must be unique
   * at any given snapshot of the index for a server. If multiple
   * files are used for a specific time period, and batch_num/batch_size
   * are both 1 (See below), then offsetting the end_timestamp is the
   * suggested method for forcing uniqueness.
   */
  protobuf_c_boolean has_start_timestamp;
  uint64_t start_timestamp;
  protobuf_c_boolean has_end_timestamp;
  uint64_t end_timestamp;
  /*
   * Region for which these keys came from (e.g., country)
   */
  char *region;
  /*
   * E.g., Batch 2 of 10. Ordinal, 1-based numbering.
   * Note: Not yet supported on iOS. Use values of 1 for both.
   */
  protobuf_c_boolean has_batch_num;
  int32_t batch_num;
  protobuf_c_boolean has_batch_size;
  int32_t batch_size;
  /*
   * Information about signatures
   * If there are multiple entries, they must be ordered in descending
   * time order by signing key effective time (most recent one first).
   * There is a limit of 10 signature infos per export file (mobile OS may
   * not check anything after that).
   */
  size_t n_signature_infos;
  SignatureInfo **signature_infos;
  /*
   * The TemporaryExposureKeys for initial release of keys.
   * Keys should be included in this list for initial release,
   * whereas revised or revoked keys should go in revised_keys.
   */
  size_t n_keys;
  TemporaryExposureKey **keys;
  /*
   * TemporaryExposureKeys that have changed status.
   * Keys should be included in this list if they have changed status
   * or have been revoked.
   */
  size_t n_revised_keys;
  TemporaryExposureKey **revised_keys;
};
#define TEMPORARY_EXPOSURE_KEY_EXPORT__INIT \
 { PROTOBUF_C_MESSAGE_INIT (&temporary_exposure_key_export__descriptor) \
    , 0, 0, 0, 0, NULL, 0, 0, 0, 0, 0,NULL, 0,NULL, 0,NULL }


struct  SignatureInfo
{
  ProtobufCMessage base;
  /*
   * Key version for rollovers
   * Must be in character class [a-zA-Z0-9_]. E.g., 'v1'
   */
  char *verification_key_version;
  /*
   * Alias with which to identify public key to be used for verification
   * Must be in character class [a-zA-Z0-9_]
   * For cross-compatibility with Apple, use MCC
   * (https://en.wikipedia.org/wiki/Mobile_country_code).
   */
  char *verification_key_id;
  /*
   * ASN.1 OID for Algorithm Identifier. Supported algorithms are
   * either 1.2.840.10045.4.3.2 or 1.2.840.10045.4.3.4
   */
  char *signature_algorithm;
};
#define SIGNATURE_INFO__INIT \
 { PROTOBUF_C_MESSAGE_INIT (&signature_info__descriptor) \
    , NULL, NULL, NULL }


struct  TemporaryExposureKey
{
  ProtobufCMessage base;
  /*
   * Key of infected user
   */
  protobuf_c_boolean has_key_data;
  ProtobufCBinaryData key_data;
  /*
   * Varying risks associated with exposure depending on type of verification
   * Ignored by the v1.5 client API when report_type is set.
   */
  protobuf_c_boolean has_transmission_risk_level PROTOBUF_C__DEPRECATED;
  int32_t transmission_risk_level PROTOBUF_C__DEPRECATED;
  /*
   * The interval number since epoch for which a key starts
   */
  protobuf_c_boolean has_rolling_start_interval_number;
  int32_t rolling_start_interval_number;
  /*
   * Increments of 10 minutes describing how long a key is valid
   */
  /*
   * defaults to 24 hours
   */
  protobuf_c_boolean has_rolling_period;
  int32_t rolling_period;
  /*
   * Type of diagnosis associated with a key.
   */
  protobuf_c_boolean has_report_type;
  TemporaryExposureKey__ReportType report_type;
  /*
   * Number of days elapsed between symptom onset and the TEK being used.
   * E.g. 2 means TEK is 2 days after onset of symptoms.
   */
  protobuf_c_boolean has_days_since_onset_of_symptoms;
  int32_t days_since_onset_of_symptoms;
};
#define TEMPORARY_EXPOSURE_KEY__INIT \
 { PROTOBUF_C_MESSAGE_INIT (&temporary_exposure_key__descriptor) \
    , 0, {0,NULL}, 0, 0, 0, 0, 0, 144, 0, TEMPORARY_EXPOSURE_KEY__REPORT_TYPE__UNKNOWN, 0, 0 }


struct  TEKSignatureList
{
  ProtobufCMessage base;
  /*
   * When there are multiple signatures, they must be sorted in time order
   * by first effective date for the signing key in descending order.
   * The most recent effective signing key must appear first.
   * There is a limit of 10 signature infos per export file (mobile OS may
   * not check anything after that).
   */
  size_t n_signatures;
  TEKSignature **signatures;
};
#define TEKSIGNATURE_LIST__INIT \
 { PROTOBUF_C_MESSAGE_INIT (&teksignature_list__descriptor) \
    , 0,NULL }


struct  TEKSignature
{
  ProtobufCMessage base;
  /*
   * Info about the signing key, version, algorithm, etc.
   */
  SignatureInfo *signature_info;
  /*
   * E.g., Batch 2 of 10
   * Must match fields from TemporaryExposureKeyExport, see
   * documentation on that message.
   */
  protobuf_c_boolean has_batch_num;
  int32_t batch_num;
  protobuf_c_boolean has_batch_size;
  int32_t batch_size;
  /*
   * Signature in X9.62 format (ASN.1 SEQUENCE of two INTEGER fields)
   */
  protobuf_c_boolean has_signature;
  ProtobufCBinaryData signature;
};
#define TEKSIGNATURE__INIT \
 { PROTOBUF_C_MESSAGE_INIT (&teksignature__descriptor) \
    , NULL, 0, 0, 0, 0, 0, {0,NULL} }


/* TemporaryExposureKeyExport methods */
void   temporary_exposure_key_export__init
                     (TemporaryExposureKeyExport         *message);
size_t temporary_exposure_key_export__get_packed_size
                     (const TemporaryExposureKeyExport   *message);
size_t temporary_exposure_key_export__pack
                     (const TemporaryExposureKeyExport   *message,
                      uint8_t             *out);
size_t temporary_exposure_key_export__pack_to_buffer
                     (const TemporaryExposureKeyExport   *message,
                      ProtobufCBuffer     *buffer);
TemporaryExposureKeyExport *
       temporary_exposure_key_export__unpack
                     (ProtobufCAllocator  *allocator,
                      size_t               len,
                      const uint8_t       *data);
void   temporary_exposure_key_export__free_unpacked
                     (TemporaryExposureKeyExport *message,
                      ProtobufCAllocator *allocator);
/* SignatureInfo methods */
void   signature_info__init
                     (SignatureInfo         *message);
size_t signature_info__get_packed_size
                     (const SignatureInfo   *message);
size_t signature_info__pack
                     (const SignatureInfo   *message,
                      uint8_t             *out);
size_t signature_info__pack_to_buffer
                     (const SignatureInfo   *message,
                      ProtobufCBuffer     *buffer);
SignatureInfo *
       signature_info__unpack
                     (ProtobufCAllocator  *allocator,
                      size_t               len,
                      const uint8_t       *data);
void   signature_info__free_unpacked
                     (SignatureInfo *message,
                      ProtobufCAllocator *allocator);
/* TemporaryExposureKey methods */
void   temporary_exposure_key__init
                     (TemporaryExposureKey         *message);
size_t temporary_exposure_key__get_packed_size
                     (const TemporaryExposureKey   *message);
size_t temporary_exposure_key__pack
                     (const TemporaryExposureKey   *message,
                      uint8_t             *out);
size_t temporary_exposure_key__pack_to_buffer
                     (const TemporaryExposureKey   *message,
                      ProtobufCBuffer     *buffer);
TemporaryExposureKey *
       temporary_exposure_key__unpack
                     (ProtobufCAllocator  *allocator,
                      size_t               len,
                      const uint8_t       *data);
void   temporary_exposure_key__free_unpacked
                     (TemporaryExposureKey *message,
                      ProtobufCAllocator *allocator);
/* TEKSignatureList methods */
void   teksignature_list__init
                     (TEKSignatureList         *message);
size_t teksignature_list__get_packed_size
                     (const TEKSignatureList   *message);
size_t teksignature_list__pack
                     (const TEKSignatureList   *message,
                      uint8_t             *out);
size_t teksignature_list__pack_to_buffer
                     (const TEKSignatureList   *message,
                      ProtobufCBuffer     *buffer);
TEKSignatureList *
       teksignature_list__unpack
                     (ProtobufCAllocator  *allocator,
                      size_t               len,
                      const uint8_t       *data);
void   teksignature_list__free_unpacked
                     (TEKSignatureList *message,
                      ProtobufCAllocator *allocator);
/* TEKSignature methods */
void   teksignature__init
                     (TEKSignature         *message);
size_t teksignature__get_packed_size
                     (const TEKSignature   *message);
size_t teksignature__pack
                     (const TEKSignature   *message,
                      uint8_t             *out);
size_t teksignature__pack_to_buffer
                     (const TEKSignature   *message,
                      ProtobufCBuffer     *buffer);
TEKSignature *
       teksignature__unpack
                     (ProtobufCAllocator  *allocator,
                      size_t               len,
                      const uint8_t       *data);
void   teksignature__free_unpacked
                     (TEKSignature *message,
                      ProtobufCAllocator *allocator);
/* --- per-message closures --- */

typedef void (*TemporaryExposureKeyExport_Closure)
                 (const TemporaryExposureKeyExport *message,
                  void *closure_data);
typedef void (*SignatureInfo_Closure)
                 (const SignatureInfo *message,
                  void *closure_data);
typedef void (*TemporaryExposureKey_Closure)
                 (const TemporaryExposureKey *message,
                  void *closure_data);
typedef void (*TEKSignatureList_Closure)
                 (const TEKSignatureList *message,
                  void *closure_data);
typedef void (*TEKSignature_Closure)
                 (const TEKSignature *message,
                  void *closure_data);

/* --- services --- */


/* --- descriptors --- */

extern const ProtobufCMessageDescriptor temporary_exposure_key_export__descriptor;
extern const ProtobufCMessageDescriptor signature_info__descriptor;
extern const ProtobufCMessageDescriptor temporary_exposure_key__descriptor;
extern const ProtobufCEnumDescriptor    temporary_exposure_key__report_type__descriptor;
extern const ProtobufCMessageDescriptor teksignature_list__descriptor;
extern const ProtobufCMessageDescriptor teksignature__descriptor;

PROTOBUF_C__END_DECLS


#endif  /* PROTOBUF_C_export_2eproto__INCLUDED */
```

## include/gatt_service.h
```c
/*
 * Copyright (c) 2020 Olaf Landsiedel
 *
 * SPDX-License-Identifier: Apache-2.0
 */

#ifndef GATT_SERVICE_H
#define GATT_SERVICE_H

int init_gatt(void);
int do_gatt(void);

#endif
```

## include/io.h
```c
/* io.h - Application main entry point */

/*
 * Copyright (c) 2020 Olaf Landsiedel
 *
 * SPDX-License-Identifier: Apache-2.0
 */

#ifndef IO_H
#define IO_H

int init_io();

#endif
```

## include/record_storage.h
```c
/*
 * Copyright (c) 2020 Olaf Landsiedel
 *
 * SPDX-License-Identifier: Apache-2.0
 */
#ifndef RECORD_STORAGE_H
#define RECORD_STORAGE_H

#include <zephyr/types.h>
#include "utility/sequencenumber.h"
#include <exposure-notification.h>



/**
 * RECORD STORAGE
 */
typedef uint64_t storage_id_t;

typedef struct bt_metadata {
    uint8_t version;
    uint8_t tx_power;
    uint8_t rsv1;
    uint8_t rsv2;
} __packed bt_metadata_t;

typedef struct associated_encrypted_metadata {
    uint8_t data[sizeof(bt_metadata_t)];
} __packed associated_encrypted_metadata_t;

typedef struct record {
    record_sequence_number_t sn;  // TODO: Convert Sequence Number
    uint32_t timestamp;           // TODO: Seconds from january first 2000 (UTC+0)
    uint8_t rssi;                  // TODO: Check correct
    ENIntervalIdentifier rolling_proximity_identifier;
    associated_encrypted_metadata_t associated_encrypted_metadata;
} __packed record_t;

typedef struct stored_records_information {
    record_sequence_number_t oldest_contact;
    uint32_t count;
} stored_records_information_t;

/**
 * Initializes the contact storage component
 * @param clean flag for indicating, if storage shall be init with clean state
 *
 * @return 0 for success
 */
int record_storage_init(bool clean);

/**
 * Reset state of record storage.
 */
void reset_record_storage();

/**
 * Loads the record with number sn into the destination struct
 * @param dest
 * @param sn
 * @return 0 in case of success
 */
int load_record(record_t* dest, record_sequence_number_t sn);

/**
 * Stores the record from src with number sn, increases latest sequence number
 * @param sn
 * @param src
 * @return 0 in case of success
 */
int add_record(record_t* src);

/**
 * Deletes the record from storage with number sn
 * @param sn the sequence number to delete
 * @return 0 in case of success
 */
int delete_record(record_sequence_number_t sn);

/**
 * TODO: How to handle if none is available?
 * @return The latest available sequence number (Caution: can actually be lower than the oldes in case of a
 * wrap-around!)
 */
record_sequence_number_t get_latest_sequence_number();

/**
 * TODO: How to handle if none is available?
 * @return The oldest available sequence number
 */
record_sequence_number_t get_oldest_sequence_number();

/**
 * @return The amount of contacts, usually get_latest_sequence_number() - get_oldest_sequence_number()
 */
uint32_t get_num_records();

int get_sequence_number_interval(record_sequence_number_t* oldest, record_sequence_number_t* latest);

/**
 * RECORD ITERATOR
 */
typedef struct record_iterator {
    /**
     * @internal
     */
    record_t current;
    /**
     * @internal
     */
    record_sequence_number_t sn_next;
    /**
     * @internal
     */
    record_sequence_number_t sn_end;  // the last sn to include
    /**
     * @internal
     */
    uint8_t finished;
} record_iterator_t;

// Also uses start and end from storage if NULL pointers given
// iterate over a sequence number range of records (Null will select the latest and newest for start / end)
// automatically
int ens_records_iterator_init_range(record_iterator_t* iterator,
                                    record_sequence_number_t* opt_start,
                                    record_sequence_number_t* opt_end);

// TODO: Do we guarantee that higher sequence numbers have at least our timestamp and lower sequence numbers up to our
// timestamp?
int ens_records_iterator_init_timerange(record_iterator_t* iterator, time_t* ts_start, time_t* ts_end);

record_t* ens_records_iterator_next(record_iterator_t* iter);

int ens_record_iterator_clear(record_iterator_t* iter);

// TODO: Is a callback the easiest thing to do? -> now it is the iterator :)
// TODO: should we really indicated the last record by sending a NULL pointer?
typedef uint8_t (*ens_record_iterator_cb_t)(const record_t* record, void* userdata);

enum {
    ENS_RECORD_ITER_STOP,      // STOP the iteration, this would not result in a NULL callback after the end is reached
    ENS_RECORD_ITER_CONTINUE,  // CONTINUE the iteration, this results in a NULL callback after the end is reached
};

// TODO: this function could be made asynchronous to handle delays in contact_storage reads?!
// TODO: How can we handle iteration while records are being added or deleted? (should be safe as long as the
// load_record function is thread safe?!)
uint8_t ens_records_iterate_with_callback(record_iterator_t* iter, ens_record_iterator_cb_t cb, void* userdata);

#endif
```

## include/sync_service.h
```c
/*
 * Copyright (c) 2020 Olaf Landsiedel
 *
 * SPDX-License-Identifier: Apache-2.0
 */

#ifndef SYNC_SERVICE_H
#define SYNC_SERVICE_H

int sync_service_init(void);
uint32_t sync_service_run(void);

#endif
```

## include/tek_storage.h
```c
/*
 * Copyright (c) 2020 Olaf Landsiedel
 *
 * SPDX-License-Identifier: Apache-2.0
 */
#ifndef tek_storage_H
#define tek_storage_H

#include <exposure-notification.h>
#include <zephyr/types.h>
#include "utility/sequencenumber.h"
#include "record_storage.h"

typedef struct tek {
    uint32_t timestamp;     // Seconds from january first 2000 (UTC+0)
    ENPeriodKey tek;        // the temporary exposure key
} __packed tek_t;

/**
 * Initializes the contact storage component
 * @param clean flag for indicating, if storage shall be init with clean state
 *
 * @return 0 for success
 */
int tek_storage_init(bool clean);

int tek_storage_add(tek_t* src);
int tek_storage_delete(tek_t* src);

/**
 * Returns 0 on success, else non zero (if none available)
 */
int tek_storage_get_latest_at_ts(tek_t* dest, uint32_t timestamp);

#endif
```

## include/tracing.h
```c
/*
 * Copyright (c) 2020 Olaf Landsiedel
 *
 * SPDX-License-Identifier: Apache-2.0
 */

#ifndef TRACING_H
#define TRACING_H

int tracing_init(void);
int tracing_run(void);

#endif
```

## include/util.h
```c
#ifndef UTIL_H
#define UTIL_H

// TODO: We should use timeutil_sync

// return the current unix timestamp in seconds
uint32_t time_get_unix_seconds();

#endif  // UTIL_H
```
